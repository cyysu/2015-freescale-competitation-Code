#include "5110.h"
 //液晶显示字符表
 const unsigned char font6x8[][6] =  
	{
  	{ 0x00, 0x00, 0x00, 0x00, 0x00, 0x00 },// sp
  	{ 0x00, 0x00, 0x00, 0x2f, 0x00, 0x00 },// !
  	{ 0x00, 0x00, 0x07, 0x00, 0x07, 0x00 },// "
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  	{ 0x14, 0x14, 0x14, 0x14, 0x14, 0x14 }// horiz lines
	};

void nk5110_init()
{	
	LCD_init();
	LCD_clear();
	LCD_set_XY(0,0);
}
void Delay_ms(uint16 ms)      //延时一毫秒
{
    int ii,jj;
    if (ms<1) ms=1;
    for(ii=0;ii<ms;ii++)     
	   for(jj=0;jj<6676;jj++)
	   {
	   	
	   }
    //80MHz--1ms  
}  

/*********************************************************** 
函数名称：LCD_write_byte
函数功能：模拟SPI接口时序写数据/命令LCD
入口参数：Data    ：写入的数据；
          Command ：写数据/命令选择；
出口参数：无 
备 注： 
***********************************************************/

void LCD_write_byte(unsigned char Data, unsigned char Command)
{
    unsigned char i;
	LCD_CE_0; 	//CE=0	     //5110片选有效，允许输入数据
	
	if(Command==1)                     //DC=Command
	   	LCD_DC_1;
    else
    	LCD_DC_0;    
    
	for(i=0;i<8;i++)				     //传送8bit数据
	{ 
			if(Data&0x80)
			 	SDIN_1;
			else
			    SDIN_0;   
			
			Data = (Data <<1);
			SCLK_0; 
     
			SCLK_1;
			 
	}
     LCD_DC_1;           //	DC=1;
     LCD_CE_1; 			//CE=1;  
     SDIN_1;			// Din=1;
					  
}
/***********************************************************************/  
/*********************************************************** 
函数名称：LCD_init
函数功能：5110初始化
入口参数：无
出口参数：无 
备 注： 
***********************************************************/
void LCD_init(void)
{
   	LCD_RST_0;    // RST = 0;     // 产生一个让LCD复位的低电平脉冲
    Delay_ms(100);						
	LCD_RST_1;       //  RST = 1;
  	LCD_CE_1;  			// CE = 1;     // 关闭LCD
    Delay_ms(100);
  	LCD_CE_0;         // CE = 0;     // 使能LCD
    Delay_ms(100);

    LCD_write_byte(0x21, 0);	// 使用扩展命令设置LCD模式,水平寻址
    LCD_write_byte(0xb8, 0);	// 设置液晶偏置电压
    LCD_write_byte(0x06, 0);	// 温度校正
    LCD_write_byte(0x13, 0);	// 1:48
    LCD_write_byte(0x20, 0);
    	// 使用基本命令，V=0，水平寻址
    LCD_clear();	           // 清屏
    LCD_write_byte(0x0c, 0);	// 设定显示模式，正常显示
   
    LCD_CE_0;  	// CE = 0;      // 使能LCD
}

/*********************************************************** 
函数名称：LCD_set_XY
函数功能：设置LCD坐标函数
入口参数：X       ：0－83
          Y       ：0－5
出口参数：无 
备 注： 
***********************************************************/
void LCD_set_XY(unsigned char X, unsigned char Y)
{
    LCD_write_byte(0x40 | Y,0 );		  // column
    LCD_write_byte(0x80 | X,0 );          // row
}
 /*******************************************************************************************
函数名称：LCD_write_char
函数功能：显示英文字符
入口参数：c	:  显示的字符
出口参数：无 
备 注： 
***********************************************************/
void LCD_write_char(unsigned char c)
{
    unsigned char line;
    c -= 32;                       //数组的行号
  	LCD_CE_0;			//  CE=0;

    for (line=0; line<6; line++)
        LCD_write_byte(font6x8[c][line], 1);
}

//**********************************************************************************

void LCD_write_str(unsigned char *p)
{
	while(*p!='\0')
	{
		LCD_write_char(*p);
		p++;
	}
}

/*------------------------------------------ 
LCD_clear: LCD清屏函数  
--------------------------------------------*/ 
void LCD_clear(void) 
{ 
 unsigned char t; 
 unsigned char k; 
 LCD_set_XY(0,0); 
 for(t=0;t<6;t++) 
	  {  
		   for(k=0;k<84;k++) 
		   {  
		    LCD_write_byte(0x00,1);   
		   }  
	  } 
} 


/*********************************************************************/

  void LCD_write_1_num(unsigned char X,unsigned char Y,signed int s)
  {
     LCD_set_XY(X,Y);
     if(s<0)
     {
     	s=0-s;
     	LCD_write_char('-');
     }
     else
     {
       	LCD_write_char(' ');	
     }
	 LCD_write_char(s+0x30);	 
  }
  
   void LCD_write_2_num(unsigned char X,unsigned char Y,signed int s)
  {
     LCD_set_XY(X,Y);
     if(s<0)
     {
     	s=0-s;
     	LCD_write_char('-');
     }
     else
     {
       	LCD_write_char(' ');	
     }
	 LCD_write_char((s/10)+0x30);
	 LCD_write_char((s%10)+0x30);	 
  }
  
  void LCD_write_3_num(unsigned char X,unsigned char Y,signed int s)
  {   
     LCD_set_XY(X,Y);
     if(s<0)
     {
     	s=0-s;
     	LCD_write_char('-');
     }
     else
     {
       	LCD_write_char(' ');	
     }
	 LCD_write_char((s/100)+0x30);
	 LCD_write_char(((s%100)/10)+0x30);
	 LCD_write_char((s%10)+0x30);	 
  }
  
  void LCD_write_4_num(unsigned char X,unsigned char Y,int s)
  {
     LCD_set_XY(X,Y);
     if(s<0)
     {
     	s=0-s;
     	LCD_write_char('-');
     }
     else
     {
       	LCD_write_char(' ');	
     }
	 LCD_write_char((s/1000)+0x30);
	 LCD_write_char(((s%1000)/100)+0x30);
	 LCD_write_char(((s%100)/10)+0x30);
	 LCD_write_char((s%10)+0x30);	 
  }
  
/***********************************************************/
void LCD_draw_bmp_pixel(unsigned char X,unsigned char Y,unsigned char hhh,uint8*Image_,uint8 r)
{
    unsigned int i;
    signed int n;
    unsigned char *p;
    unsigned char CCD_temp[84];
    p=CCD_temp;
    for (n=0;n<155;n=n+2)
    {
        *p = (Image_[n+hhh*r]-254) +(Image_[n+(hhh+1)*r]-254)*2+ (Image_[n+(hhh+2)*r]-254)*4+ (Image_[n+(hhh+3)*r]-254)*8+
             (Image_[n+(hhh+4)*r]-254)*16+(Image_[n+(hhh+5)*r]-254)*32+(Image_[n+(hhh+6)*r]-254)*64+(Image_[n+(hhh+7)*r]-254)*128;    
        p++;
    }
    
    
   
        LCD_set_XY(X,Y);
        for(i=0; i<84; i++)
        {
            LCD_write_byte(~CCD_temp[i], 1);
        }
  
}

void show_lcd(uint8*I,uint8 C)
{
    LCD_draw_bmp_pixel(0,0, 0,I,C);    // 
    LCD_draw_bmp_pixel(0,1, 8,I,C);    // 
    LCD_draw_bmp_pixel(0,2,16,I,C);    // 
    LCD_draw_bmp_pixel(0,3,24,I,C);    // 
    LCD_draw_bmp_pixel(0,4,30,I,C);    //
}